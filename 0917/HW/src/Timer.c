/*********************************************************************************************************
* 模块名称：Timer.c
* 摘    要：Timer模块
* 当前版本：1.0.0
* 作    者：Rengar
* 完成日期：2024年01月01日  
* 内    容：
* 注    意：                                                                  
**********************************************************************************************************
* 取代版本：
* 作    者：
* 完成日期：
* 修改内容：
* 修改文件：
*********************************************************************************************************/

/*********************************************************************************************************
*                                              包含头文件
*********************************************************************************************************/
#include "Timer.h"
#include "gd32f30x_conf.h"
/*********************************************************************************************************
*                                              宏定义
*********************************************************************************************************/

/*********************************************************************************************************
*                                              枚举结构体
*********************************************************************************************************/

/*********************************************************************************************************
*                                              内部变量定义
*********************************************************************************************************/

static unsigned char s_i2msFlag = FALSE;
static unsigned char s_i1secFlag = FALSE;

/*********************************************************************************************************
*                                              内部函数声明
*********************************************************************************************************/

static void ConfigTimer2(unsigned short arr,unsigned short psc);

static void ConfigTimer4(unsigned short arr,unsigned short psc);
/*********************************************************************************************************
*                                              内部函数实现
*********************************************************************************************************/

/*********************************************************************************************************
* 函数名称：ConfigTimer2
* 函数功能：配置TIMER2
* 输入参数：arr-自动重装值，psc-预分频器值
* 输出参数：void
* 返 回 值：void
* 创建日期：2024年01月01日
* 注    意：APB1的时钟是60MHZ,TIMER2和TIMER4是APB1的2倍，因此TIMER2和TIMER4的时钟为120MHZ
*********************************************************************************************************/

static void ConfigTimer2(unsigned short arr,unsigned short psc)
{
	timer_parameter_struct timer_initpara;
//使能RCU相关时钟
	rcu_periph_clock_enable(RCU_TIMER5);
	timer_deinit(TIMER5);
	timer_struct_para_init(&timer_initpara);
	
//配置Timer2
	timer_initpara.prescaler = psc;
	timer_initpara.counterdirection = TIMER_COUNTER_UP;
	timer_initpara.period = arr;
	timer_initpara.clockdivision = TIMER_CKDIV_DIV1;
	timer_init(TIMER2,&timer_initpara);
	
	timer_interrupt_enable(TIMER5,TIMER_INT_UP);
	nvic_irq_enable(TIMER5_IRQn,1,0);
	timer_enable(TIMER5);
}

static void ConfigTimer4(unsigned short arr,unsigned short psc)
{
	timer_parameter_struct timer_initpara;
	rcu_periph_clock_enable(RCU_TIMER6);
	timer_deinit(TIMER6);
	timer_struct_para_init(&timer_initpara);
	
	timer_initpara.prescaler = psc;
	timer_initpara.counterdirection = TIMER_COUNTER_UP;
	timer_initpara.period = arr;
	timer_initpara.clockdivision = TIMER_CKDIV_DIV1;
	timer_init(TIMER6,&timer_initpara);
	timer_interrupt_enable(TIMER6,TIMER_INT_UP);
	nvic_irq_enable(TIMER6_IRQn,1,0);
	
	timer_enable(TIMER6);
}


/*********************************************************************************************************
* 函数名称：TIMER2_IRQHandler
* 函数功能：TIMER2中断服务函数 
* 输入参数：void
* 输出参数：void
* 返 回 值：void
* 创建日期：2024年01月01日
* 注    意：每毫秒进入一次中断服务函数
*********************************************************************************************************/

void TIMER5_IRQHandler(void)
{
	static unsigned short s_iCnt2 = 0;
	
	if(timer_interrupt_flag_get(TIMER5,TIMER_INT_FLAG_UP)==SET)
	{
		timer_interrupt_flag_clear(TIMER5,TIMER_INT_FLAG_UP);
	}
	s_iCnt2++;
	if(s_iCnt2>=20)
	{
		s_iCnt2=0;
		s_i2msFlag = TRUE;
	}	
}


/*********************************************************************************************************
* 函数名称：TIMER6_IRQHandler
* 函数功能：TIMER4中断服务函数 
* 输入参数：void
* 输出参数：void
* 返 回 值：void
* 创建日期：2024年01月01日
* 注    意：每毫秒进入一次中断服务函数
*********************************************************************************************************/

void TIMER6_IRQHandler(void)
{
	static signed short s_iCnt1000 = 0;
	
	if(timer_interrupt_flag_get(TIMER6,TIMER_INT_FLAG_UP)==SET)
	{
		timer_interrupt_flag_clear(TIMER6,TIMER_INT_FLAG_UP);
	}
		
	s_iCnt1000++;
	if(s_iCnt1000>=1000)
	{
		s_iCnt1000=0;
		s_i1secFlag = TRUE;
	}	
}

/*********************************************************************************************************
*                                              API函数实现
*********************************************************************************************************/

/*********************************************************************************************************
* 函数名称：InitTimer
* 函数功能：初始化Timer模块 
* 输入参数：void
* 输出参数：void
* 返 回 值：void
* 创建日期：2024年01月01日
* 注    意：使用的TIMER2和TIMER4由APB1(60MHz)预分频后输出。如果预分频为1，则由APB1*1输出，否则由APB1*2(120MHz)输出
*********************************************************************************************************/
void InitTimer(void)
{
	ConfigTimer2(999,119);
	ConfigTimer4(999,119);
}

/*********************************************************************************************************
* 函数名称：Get2msFlag
* 函数功能：获取2ms标志位的值  
* 输入参数：void
* 输出参数：void
* 返 回 值：s_i2msFlag-2ms标志位的值
* 创建日期：2024年01月01日
* 注    意：
*********************************************************************************************************/
unsigned char Get2msFlag(void)
{
  return(s_i2msFlag);     //返回2ms标志位的值
}

/*********************************************************************************************************
* 函数名称：Clr2msFlag
* 函数功能：清除2ms标志位的值  
* 输入参数：void
* 输出参数：void
* 返 回 值：void
* 创建日期：2024年01月01日
* 注    意：
*********************************************************************************************************/
void Clr2msFlag(void)
{
  s_i2msFlag = FALSE;     //返回2ms标志位的值
}

/*********************************************************************************************************
* 函数名称：Get1SecFlag
* 函数功能：获取1s标志位的值  
* 输入参数：void
* 输出参数：void
* 返 回 值：s_i1secFlag-1s标志位的值
* 创建日期：2024年01月01日
* 注    意：
*********************************************************************************************************/
unsigned char Get1SecFlag(void)
{
	return(s_i1secFlag);
}


/*********************************************************************************************************
* 函数名称：Clr1SecFlag
* 函数功能：获取1s标志位的值  
* 输入参数：void
* 输出参数：void
* 返 回 值：void
* 创建日期：2024年01月01日
* 注    意：
*********************************************************************************************************/
void Clr1SecFlag(void)
{
	s_i1secFlag = FALSE;
}










